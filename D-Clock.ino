/*
 * Program: OLED Digital Watch
 * Version: 1.0
 * Author: MAD Walker
 */

#include <Arduino.h>
#include <Wire.h>
#include <Adafruit_SSD1306.h>
#include <Adafruit_GFX.h>
//http://www.rinkydinkelectronics.com/library.php?id=73
#include <DS3231.h>
#include <LowPower.h>

// 'quantino_logo', 128x64px
const unsigned char quantino_logo_big [] PROGMEM = {
  0x00, 0x00, 0x00, 0x00, 0x00, 0x00, 0x00, 0x00, 0x00, 0x00, 0x00, 0x00, 0x00, 0x00, 0x00, 0x00,
  0x00, 0x00, 0x00, 0x00, 0x1f, 0xff, 0xff, 0xff, 0xff, 0xff, 0xff, 0xe0, 0x00, 0x00, 0x00, 0x00,
  0x00, 0x00, 0x00, 0x00, 0x7f, 0xff, 0xff, 0xff, 0xff, 0xff, 0xff, 0xf8, 0x00, 0x00, 0x00, 0x00,
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  0x00, 0x00, 0x00, 0x00, 0x00, 0x00, 0x00, 0x00, 0x00, 0x00, 0x00, 0x00, 0x00, 0x00, 0x00, 0x00
};

// 'quantino_logo', 16x10px
const unsigned char quantino_logo [] PROGMEM = {
  0x7f, 0xfe, 0xff, 0xff, 0xc0, 0x03, 0xc0, 0x03, 0xc7, 0x83, 0xc3, 0xc3, 0xc1, 0xe3, 0xc0, 0xf3,
  0xfe, 0x7f, 0x7f, 0x1e
};

// 'battery_empty', 25x10px
const unsigned char battery_icon [] PROGMEM = {
  0x3f, 0xff, 0xff, 0x80, 0x20, 0x00, 0x00, 0x80, 0xe0, 0x00, 0x00, 0x80, 0xe0, 0x00, 0x00, 0x80,
  0xe0, 0x00, 0x00, 0x80, 0xe0, 0x00, 0x00, 0x80, 0xe0, 0x00, 0x00, 0x80, 0xe0, 0x00, 0x00, 0x80,
  0x20, 0x00, 0x00, 0x80, 0x3f, 0xff, 0xff, 0x80
};


#define OLED_ADDR                     0x3C
#define BATT_V                        A6
#define BUTTON_TILT                   2
#define BUTTON_ADJ                    3
#define BUTTON_SET                    4

Adafruit_SSD1306                    display(128, 64, &Wire, -1, 400000UL, 100000UL);
DS3231                              dRTC(SDA, SCL);

Time t;
int batteryLevel = 0;
int batteryLevelcounter = 0;
float batteryADC = 0;
volatile float prevBatteryADC = 0;
int prevBatteryADCAvg = 0;
float realVoltage = 0;
int realVoltageOffset = 0;
int temp = 0;
int hour24 = 0;
int hour12 = 0;
int newMin = 0;
int newDate = 0;
int newMonth = 0;
int newYear = 0;
int newDay = 0;
char AMPM = 'A';
int dim = LOW;
int configMode = LOW;
int configIndex = 0;
int configCounter = 0;
unsigned long clockMillis = 0;
const unsigned long clockPeriod = 10000;
volatile unsigned long clockStartMillis = 0;
unsigned long currentMillis = 0;
const unsigned long period = 100;
unsigned long startMillis = 0;

void setup() {
  pinMode(BUTTON_SET, INPUT);
  pinMode(BUTTON_ADJ, INPUT);
  pinMode(BUTTON_TILT, INPUT);
  digitalWrite(BUTTON_SET, LOW);
  digitalWrite(BUTTON_ADJ, LOW);
  digitalWrite(BUTTON_TILT, LOW);
  dRTC.begin();
  display.begin(SSD1306_SWITCHCAPVCC, OLED_ADDR);
  delay(50);
  display.clearDisplay();
  display.drawBitmap(0, 0, quantino_logo_big, 128, 64, WHITE);
  display.dim(dim);
  display.display();
  delay(1000);
  display.clearDisplay();
  drawBatteryIcon();
  batteryADC = analogRead(BATT_V);
  realVoltage = batteryADC * 0.004882814;
  batteryLevel = map(realVoltage * 100, 300, 420, 0, 10);
}

void loop() {
  setBrightness();
  if (digitalRead(BUTTON_SET) == HIGH) {
    while (digitalRead(BUTTON_SET) == HIGH && configCounter < 5) {
      configCounter++;
      delay(1000);
    }
    if (configCounter >= 5) {
      while (digitalRead(BUTTON_SET) == HIGH) {
        delay(50);
      }
      configMode = HIGH;
      configIndex++;
      display.clearDisplay();
    }
    else {
      configCounter = 0;
    }
  }
  if (configMode == LOW) {
    updateTime();
    getBatteryLevel();
    updateBatteryLevel();
    display.display();
    clockMillis = millis();
    if (clockMillis - clockStartMillis >= clockPeriod) {
      display.clearDisplay();
      display.display();
      attachInterrupt(digitalPinToInterrupt(BUTTON_ADJ), wakeUp, HIGH);
      attachInterrupt(digitalPinToInterrupt(BUTTON_TILT), wakeUp, HIGH);
      LowPower.powerDown(SLEEP_FOREVER, ADC_OFF, BOD_OFF);
      detachInterrupt(digitalPinToInterrupt(BUTTON_ADJ));
      detachInterrupt(digitalPinToInterrupt(BUTTON_TILT));
      delay(100);
    }
  } else {
    display.clearDisplay();
    display.setTextSize(1);
    display.setTextColor(WHITE, BLACK);
    display.setCursor(0, 1);
    display.print("SETTINGS:");
    switch (configIndex) {
      case 1:
        setHour();
        break;
      case 2:
        setMinute();
        break;
      case 3:
        setDate();
        break;
      case 4:
        setMonth();
        break;
      case 5:
        setYear();
        break;
      default:
        configIndex = 0;
        configMode = LOW;
        configCounter = 0;
        display.clearDisplay();
        clockStartMillis = millis();
    }
    display.display();
  }
}

void wakeUp() {
  clockStartMillis = millis();
  prevBatteryADC = 0;
}

void setBrightness() {
  int counter = 0;
  if (digitalRead(BUTTON_ADJ) == HIGH && configMode == LOW) {
    while (digitalRead(BUTTON_ADJ) == HIGH) {
      counter++;
      delay(500);
      if (counter > 4) {
        dim = !dim;
        display.clearDisplay();
        break;
      }
    }
    display.dim(dim);
    clockStartMillis = millis();
  }
}

void setHour() {
  display.setTextSize(2);
  display.setCursor(0, 34);
  display.print("HOUR: ");
  display.setTextSize(4);
  display.setCursor(80, 25);
  t = dRTC.getTime();
  hour24 = t.hour;
  if (digitalRead(BUTTON_ADJ) == HIGH) {
    hour24++;
    if (hour24 > 23) {
      hour24 = 0;
    }
    dRTC.setTime(hour24, t.min, t.sec);
    delay(250);
  }
  if (hour24 < 10) {
    display.print("0");
  }
  display.print(hour24);
}

void setMinute() {
  display.setTextSize(2);
  display.setCursor(0, 34);
  display.print("MIN: ");
  display.setTextSize(4);
  display.setCursor(80, 25);
  t = dRTC.getTime();
  newMin = t.min;
  if (digitalRead(BUTTON_ADJ) == HIGH) {
    newMin++;
    if (newMin > 59) {
      newMin = 0;
    }
    dRTC.setTime(t.hour, newMin, t.sec);
    delay(250);
  }
  if (newMin < 10) {
    display.print("0");
  }
  display.print(newMin);
}

void setDate() {
  display.setTextSize(2);
  display.setCursor(0, 34);
  display.print("DATE: ");
  display.setTextSize(4);
  display.setCursor(80, 25);
  t = dRTC.getTime();
  newDate = t.date;
  if (digitalRead(BUTTON_ADJ) == HIGH) {
    newDate++;
    if (newDate > 31) {
      newDate = 1;
    }
    dRTC.setDate(newDate, t.mon, t.year);
    dRTC.setDOW();
    delay(250);
  }
  if (newDate < 10) {
    display.print("0");
  }
  display.print(newDate);
}

void setMonth() {
  display.setTextSize(2);
  display.setCursor(0, 34);
  display.print("MONTH: ");
  display.setTextSize(4);
  display.setCursor(80, 25);
  t = dRTC.getTime();
  newMonth = t.mon;
  if (digitalRead(BUTTON_ADJ) == HIGH) {
    newMonth++;
    if (newMonth > 12) {
      newMonth = 1;
    }
    dRTC.setDate(t.date, newMonth, t.year);
    dRTC.setDOW();
    delay(250);
  }
  if (newMonth < 10) {
    display.print("0");
  }
  display.print(newMonth);
}

void setYear() {
  display.setTextSize(2);
  display.setCursor(0, 34);
  display.print("YEAR: ");
  display.setCursor(80, 34);
  t = dRTC.getTime();
  newYear = t.year;
  if (digitalRead(BUTTON_ADJ) == HIGH) {
    newYear++;
    if (newYear > 2100) {
      newYear = 2022;
    }
    dRTC.setDate(t.date, t.mon, newYear);
    dRTC.setDOW();
    delay(250);
  }
  if (newYear < 10) {
    display.print("0");
  }
  display.print(newYear);
}

void updateTime() {
  t = dRTC.getTime();
  //TEMP
  display.drawBitmap(0, 0, quantino_logo, 16, 10, WHITE);
  display.setTextSize(1);
  display.setCursor(24, 2);
  temp = dRTC.getTemp();
  display.print(temp);
  if (temp < 10) {
    display.print("0");
  }
  display.print((char)247);
  display.print("C");
  //DOW
  display.setCursor(79, 2);
  display.print(dRTC.getDOWStr(FORMAT_SHORT));
  //TIME
  display.setTextSize(4);
  display.setCursor(7, 20);
  hour24 = t.hour;
  AMPM = 'A';
  if (hour24 == 0) {
    hour12 = 12;
  } else if (hour24 > 12) {
    hour12 = hour24 - 12;
    AMPM = 'P';
  } else {
    hour12 = hour24;
  }
  if (hour12 < 10) {
    display.print("0");
  }
  display.print(hour12);
  display.print(":");
  if (t.min < 10) {
    display.print("0");
  }
  display.print(t.min);
  // DATE
  display.setTextSize(1);
  display.setTextColor(WHITE, BLACK);
  display.setCursor(0, 57);
  if (t.date < 10) {
    display.print("0");
  }
  display.print(t.date);
  display.print(" ");
  display.print(dRTC.getMonthStr(FORMAT_SHORT));
  display.print(" ");
  display.print(t.year);
  //Seconds
  display.setTextSize(1);
  display.setCursor(98, 57);
  if (t.sec < 10) {
    display.print("0");
  }
  display.print(t.sec);
  //AMPM
  display.print(" ");
  display.print(AMPM);
  display.print("M");
}

void drawBatteryIcon() {
  display.drawBitmap(103, 0, battery_icon, 25, 10, WHITE);
}

void getBatteryLevel() {
  currentMillis = millis();
  if (currentMillis - startMillis >= period) {
    batteryADC = analogRead(BATT_V);
    if (prevBatteryADC > batteryADC) {
      batteryADC = prevBatteryADC;
    } else {
      prevBatteryADC = batteryADC;
    }
    prevBatteryADCAvg = prevBatteryADCAvg + batteryADC;
    batteryLevelcounter++;
    if (batteryLevelcounter >= 10) {
      batteryADC = prevBatteryADCAvg / batteryLevelcounter;
      realVoltage = batteryADC * 0.004882814;
      realVoltageOffset = realVoltage * 100;
      batteryLevel = map(realVoltageOffset, 300, 410, 0, 10);
      prevBatteryADCAvg = 0;
      prevBatteryADC = 0;
      batteryLevelcounter = 0;
    }
    startMillis = currentMillis;
  }
}

void updateBatteryLevel() {
  int x, mapValue;
  drawBatteryIcon();
  if (batteryLevel > 10) {
    batteryLevel = 10;
  } else if (batteryLevel < 0) {
    batteryLevel = 0;
  }
  mapValue = map(batteryLevel, 10, 0, 106, 124);
  for (x = 125; x >= mapValue; x--) {
    if (x % 2 != 0) {
      display.drawFastVLine(x, 2, 6, WHITE);
    }
  }
  for (x = mapValue; x >= 106; x--) {
    display.drawFastVLine(x, 2, 6, BLACK);
  }
}
